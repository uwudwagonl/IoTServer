// ============================================================================
// ESP32 → HTL-IoT MQTT broker — TLS + client-certificate template
// Drop-in. Edit the CONFIG block, paste the PEMs from <name>_certs.h
// (output of /opt/iot-cert/issue.py on the Pi), and you're done.
// No sensors — wire your own data into pub() in loop().
// ============================================================================
#include <WiFi.h>
#include "esp_wpa2.h"
#include <WiFiClientSecure.h>
#include <PubSubClient.h>
#include <time.h>

// -------------------------- CONFIG ------------------------------------------
// WiFi (HTLVB WPA2-Enterprise)
#define WIFI_SSID  "HTLVB"
#define WIFI_USER  "htlgast.iot4wi-01"
#define WIFI_PASS  "10om7"

// Broker — TLS+cert listener on the Pi (LAN only).
#define MQTT_HOST  "10.252.74.225"
#define MQTT_PORT  8883

// How often the heartbeat publishes.
#define PUBLISH_MS 5000

// Topic namespaces. Must be subsets of what issue.py granted!
//   pub → TOPIC_PUB_BASE/<DEVICE_NAME>/<key>
//   sub → TOPIC_SUB_BASE/<DEVICE_NAME>/#
#define TOPIC_PUB_BASE  "sensors"
#define TOPIC_SUB_BASE  "commands"

// ---- PASTE THE CONTENTS OF <name>_certs.h HERE -----------------------------
// Generated by:  sudo /opt/iot-cert/issue.py <name> <pub-pattern> <sub-pattern>
// then:          sudo cat /opt/iot-cert/issued/<name>/<name>_certs.h
static const char DEVICE_NAME[] = "REPLACE-ME";

static const char CA_CERT_PEM[] PROGMEM = R"PEM(
-----BEGIN CERTIFICATE-----
PASTE CA CERT HERE
-----END CERTIFICATE-----
)PEM";

static const char CLIENT_CERT_PEM[] PROGMEM = R"PEM(
-----BEGIN CERTIFICATE-----
PASTE CLIENT CERT HERE
-----END CERTIFICATE-----
)PEM";

static const char CLIENT_KEY_PEM[] PROGMEM = R"PEM(
-----BEGIN RSA PRIVATE KEY-----
PASTE CLIENT KEY HERE
-----END RSA PRIVATE KEY-----
)PEM";
// ----------------------------------------------------------------------------

WiFiClientSecure netClient;
PubSubClient     mqtt(netClient);

String   pubBase, subTopic, lwtTopic;
uint32_t lastPub = 0;

// ===== WIFI =================================================================
void connectWifi() {
  Serial.printf("WiFi: %s ", WIFI_SSID);
  WiFi.disconnect(true);
  WiFi.mode(WIFI_STA);
  esp_wifi_sta_wpa2_ent_set_identity((uint8_t*)WIFI_USER, strlen(WIFI_USER));
  esp_wifi_sta_wpa2_ent_set_username((uint8_t*)WIFI_USER, strlen(WIFI_USER));
  esp_wifi_sta_wpa2_ent_set_password((uint8_t*)WIFI_PASS, strlen(WIFI_PASS));
  esp_wifi_sta_wpa2_ent_enable();
  WiFi.begin(WIFI_SSID);
  while (WiFi.status() != WL_CONNECTED) { delay(400); Serial.print("."); }
  Serial.printf(" ok IP=%s RSSI=%d\n",
                WiFi.localIP().toString().c_str(), WiFi.RSSI());
}

// ===== TIME (TLS validation needs a clock) ==================================
void syncTime() {
  configTime(0, 0, "pool.ntp.org", "time.nist.gov");
  Serial.print("Time sync");
  time_t now = 0;
  for (int i = 0; i < 30 && now < 1700000000; i++) {
    delay(500); Serial.print(".");
    time(&now);
  }
  Serial.printf(" %s", ctime(&now));
}

// ===== MQTT =================================================================
void onMqttMessage(char* topic, byte* payload, unsigned int len) {
  String body; body.reserve(len);
  for (unsigned int i = 0; i < len; i++) body += (char)payload[i];
  Serial.printf("[recv] %s : %s\n", topic, body.c_str());
  // -----------------------------------------------------------------
  // TODO: react to incoming commands here. Examples:
  //   if (String(topic).endsWith("/led")) digitalWrite(LED, body == "on");
  //   if (body == "reboot") ESP.restart();
  // -----------------------------------------------------------------
}

void connectMqtt() {
  netClient.setCACert(CA_CERT_PEM);
  netClient.setCertificate(CLIENT_CERT_PEM);
  netClient.setPrivateKey(CLIENT_KEY_PEM);

  mqtt.setServer(MQTT_HOST, MQTT_PORT);
  mqtt.setCallback(onMqttMessage);
  mqtt.setKeepAlive(60);
  mqtt.setBufferSize(1024);

  while (!mqtt.connected()) {
    Serial.printf("MQTT: %s:%d as %s ... ", MQTT_HOST, MQTT_PORT, DEVICE_NAME);
    bool ok = mqtt.connect(DEVICE_NAME, nullptr, nullptr,
                           lwtTopic.c_str(), 0, true, "offline");
    if (ok) {
      Serial.println("ok");
      mqtt.publish(lwtTopic.c_str(), "online", true);
      mqtt.subscribe(subTopic.c_str(), 1);
      Serial.printf("subscribed: %s\n", subTopic.c_str());
    } else {
      Serial.printf("rc=%d, retry 3s\n", mqtt.state());
      delay(3000);
    }
  }
}

// ===== Publish helpers ======================================================
// Publishes under sensors/<DEVICE_NAME>/<key>. Retained by default so the
// dashboard always shows the latest value.
void pub(const char* key, const String& val, bool retain = true) {
  String t = pubBase + "/" + key;
  mqtt.publish(t.c_str(), val.c_str(), retain);
}
void pub(const char* key, float v, uint8_t dec = 2) {
  char b[16]; dtostrf(v, 1, dec, b); pub(key, String(b));
}
void pub(const char* key, long v) { pub(key, String(v)); }

// ===== Lifecycle ============================================================
void setup() {
  Serial.begin(115200);
  delay(500);
  Serial.printf("\n=== %s booting ===\n", DEVICE_NAME);

  pubBase  = String(TOPIC_PUB_BASE) + "/" + DEVICE_NAME;
  subTopic = String(TOPIC_SUB_BASE) + "/" + DEVICE_NAME + "/#";
  lwtTopic = pubBase + "/status";

  connectWifi();
  syncTime();
  connectMqtt();
}

void loop() {
  if (WiFi.status() != WL_CONNECTED) connectWifi();
  if (!mqtt.connected())             connectMqtt();
  mqtt.loop();

  if (millis() - lastPub < PUBLISH_MS) return;
  lastPub = millis();

  // Always-on heartbeat. Add your own readings here.
  pub("uptime_s", (long)(millis() / 1000));
  pub("rssi",     (long)WiFi.RSSI());

  Serial.printf("[hb] up=%lus rssi=%d\n",
                (unsigned long)(millis() / 1000), WiFi.RSSI());
}
